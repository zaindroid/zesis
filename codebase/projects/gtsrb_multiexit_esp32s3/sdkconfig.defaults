## codebase/projects/npu_dc/primary/Kconfig.sysbuild
```kconfig
#
# Copyright 2024 NXP
#
# SPDX-License-Identifier: BSD-3-Clause

rsource "${SdkRootDirPath}/examples/multicore_examples/Kconfig.sysbuild"
```
